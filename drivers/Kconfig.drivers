## drivers/Kconfig.drivers
```kconfig
menu "ADS Pin layout"
    
    config I2C_MASTER_SCL
        int "Connected i2c SCL GPIO"
        range ENV_GPIO_RANGE_MIN ENV_GPIO_OUT_RANGE_MAX
        default 2
        help
            GPIO number for I2C SCL of ADS converter.
    
    config I2C_MASTER_SDA
        int "Connected i2c SDA GPIO"
        range ENV_GPIO_RANGE_MIN ENV_GPIO_OUT_RANGE_MAX
        default 1
        help
            GPIO number for I2C SDA of ADS converter.
    
    config ADS1115_READY_INT
        int "Connected i2c READY_PIN GPIO"
        range ENV_GPIO_RANGE_MIN ENV_GPIO_OUT_RANGE_MAX
        default 3
        help
            GPIO number for the ready pin that of ADS converter,
            used to trigger interrupt to read once ready
    
endmenu

menu "ADS converter config"
    config UPSTREAM_PRESSURE_CH
        int "ADC Channel for Upstream pressure sensor"
        range 0 4
        default 2
        help
            Check the shematic to get the correct ADC channel regarding 
            connecting pin on the terminal block.
    
    config DOWNSTREAM_PRESSURE_CH
        int "ADC Channel for Upstream pressure sensor"
        range 0 4
        default 3
        help
            Check the shematic to get the correct ADC channel regarding 
            connecting pin on the terminal block.
    
    config WATER_LEVEL_CH
        int "ADC Channel for Water level sensor"
        range 0 3
        default 1
        help
            Check the shematic to get the correct ADC channel regarding 
            connecting pin on the terminal block.
    
    config DELAY_ADS_DRIVER
        int "Delay in ms between 2 queries to ADS to perform conversions"
        range 100 60000
        default 1000
        help
            This will query the conversion for all the 4 channels at this delay.

    config DELAY_TEMPERATURE_DRIVER
        int "Delay in ms between 2 queries to ESP internal temperature sensor"
        range 100 60000
        default 1000
        help
            This will set up a periodic task to read this temperature.
endmenu
```

## main/Kconfig.main
```kconfig
menu "Pin layout"
    config PIN_LED
        int "On Board LED GPIO Num"
        range ENV_GPIO_RANGE_MIN ENV_GPIO_OUT_RANGE_MAX
        default 23
        help
            GPIO number for Led that App will use as UI.
    
    config PIN_BUTTON
        int "On Board Button GPIO Num"
        range ENV_GPIO_RANGE_MIN ENV_GPIO_OUT_RANGE_MAX
        default 9
        help
            GPIO number for the button that App will use as UI.
    
    config VOLUME_METER_PIN
        int "Connected Impulsion volume meter"
        range ENV_GPIO_RANGE_MIN ENV_GPIO_OUT_RANGE_MAX
        default 15
        help
            GPIO number for Impulsion volumetric meter.
            Should have a pull up and an RC network for debouncing.
endmenu

menu "Zigbee endpoints"
    config WATERMETER_EP
        int "Watermeter Endpoint"
        range 0 1024
        default 1
        help
           Zigbee endpoint for watermeter.
    
    config UPSTREAM_EP
        int "Upstream Endpoint"
        range 0 1024
        default 2
        help
            Zigbee endpoint for upstream pressure.
    
    config DOWNSTREAM_EP
        int "downstream Endpoint"
        range 0 1024
        default 3
        help
            Zigbee endpoint for downstream pressure.
endmenu
```

## main/Kconfig.projbuild
```kconfig
menu "Project Settings"
    
    orsource "$IDF_PATH/examples/common_components/env_caps/$IDF_TARGET/Kconfig.env_caps"

    config PIN_LED
        int "On Board LED GPIO Num"
        range ENV_GPIO_RANGE_MIN ENV_GPIO_OUT_RANGE_MAX
        default 23
        help
            GPIO number for Led that App will use as UI.
    

    rsource "./../components/zigbee/Kconfig.zb"
    rsource "./../drivers/Kconfig.drivers"

    comment "Module Debugging"

    
endmenu
```
